//This example reads a MIFARE memory block. It is tested with a new MIFARE 1K cards. Uses default keys.
//Contributed by Seeed Technology Inc (www.seeedstudio.com)

#include <PN532.h>
#include <SPI.h>

/*Chip select pin can be connected to D10 or D9 which is hareware optional*/
/*if you the version of NFC Shield from SeeedStudio is v2.0.*/
#define PN532_CS 10

PN532 nfc(PN532_CS);


void setup(void) {
  Serial.begin(9600);
  nfc.begin();

  uint32_t versiondata = nfc.getFirmwareVersion();
  if (! versiondata) {
    while (1); // halt
  }
  nfc.SAMConfig();

/*MAIN PROGRAM*/
  uint8_t k0=0xFF;
  uint8_t k1=0xFF;
  uint8_t k2=0xFF;
  uint8_t k3=0xFF;
  uint8_t k4=0xFF;
  uint8_t k5=0xFF;
  uint8_t delta=0x01;

  uint8_t  my[] = {
    0x00,0x01,0x02,0x03,0x04,0x05,0x06,0x07,0x08,0x09,0x0A,0x0B,0x0C,0x0D,0x0E,0x0F,
    0x10,0x11,0x12,0x13,0x14,0x15,0x16,0x17,0x18,0x19,0x1A,0x1B,0x1C,0x1D,0x1E,0x1F,
    0x20,0x21,0x22,0x23,0x24,0x25,0x26,0x27,0x28,0x29,0x2A,0x2B,0x2C,0x2D,0x2E,0x2F,
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    0xF0,0xF1,0xF2,0xF3,0xF4,0xF5,0xF6,0xF7,0xF8,0xF9,0xFA,0xFB,0xFC,0xFD,0xFE,0xFF
  };
  

  uint32_t id;
  id = nfc.readPassiveTargetID(PN532_MIFARE_ISO14443A);
  Serial.println("");  
  /*if(nfc.authenticateBlock(1, id ,0x04,KEY_A, my[15],my[15],my[15],my[15],my[15],my[15])){
      Serial.println("YESS Default Key ");
    }
    else{
      Serial.println("No Default Key");
      }
  */


  
  //CRAKING MIFARE KEY
  String mifareKey="";
  for(uint32_t i=255;i<=255;i++){
    //[*][][][][][]
    for(uint32_t j=255;j<=255;j++){
      //[*][*][][][][]
      for(uint32_t k=255;k<=255;k++){
        //[*][*][*][][][]
        for(uint32_t l=255;l<=255;l++){
          //[*][*][*][*][][]
          for(uint32_t m=255;m<=255;m++){
            //[*][*][*][*][*][]
            for(uint32_t n=200;n<=255;n++){
              //[*][*][*][*][*][*]
              if(nfc.authenticateBlock(1, id ,0x04,KEY_A,my[i],my[j],my[k],my[l],my[m],my[n])){
                Serial.println("KEY FOUUND");
                String mifareKey="["+String(my[i])+":"+String(my[j])+":"+String(my[k])+":"+String(my[l])+":"+String(my[m])+":"+String(my[n])+"]";
                delay(500000000000000000000000000000000000000000000000000000000000000000000000000000000000000);
              }
              else{
              //prevent blocking device
                id = nfc.readPassiveTargetID(PN532_MIFARE_ISO14443A);
              }
              Serial.println("");
              Serial.print("[");
                Serial.print(i);
                Serial.print(":");
                Serial.print(j);
                Serial.print(":");
                Serial.print(k);
                Serial.print(":");
                Serial.print(l);
                Serial.print(":");
                Serial.print(m);
                Serial.print(":");
                Serial.print(n);
                Serial.println("]");
              Serial.println("----------------------------------");
              delay(1000);
            }
          }
        }
      }
    }
  }
 Serial.println("KEY FOUUND");
 Serial.println(mifareKey);

  /*
  for(uint32_t i=220;i<=255;i++){
    //unsigned long aa = unsigned long my[i];
    Serial.print("Iterando en:");
    Serial.print(i);
    //uint8_t keys[]= {  my[i],0xFF,0xFF,0xFF,0xFF,0xFF };
    
      Serial.println("");
      Serial.print("Checando valor i =  ");
      Serial.println(i);
      //
     if(nfc.authenticateBlock(1, id ,0x04,KEY_A,my[255],my[255],my[255],my[255],my[255],my[i])){
        Serial.println("KEY FOUUND");
        }
      else{
        Serial.println("NEL");
        //prevent blocking device
        id = nfc.readPassiveTargetID(PN532_MIFARE_ISO14443A);
        }
      //
    
      
    Serial.println("");
    Serial.println("----------------------------------");
    delay(50);
    }*/
  //delay(000);
}

void loop(void) {
}


